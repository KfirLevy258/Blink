## CMakeLists.txt
```
cmake_minimum_required(VERSION 3.20.0)
find_package(Zephyr REQUIRED HINTS $ENV{ZEPHYR_BASE})
project(claude_usage_display)

target_sources(app PRIVATE
	src/main.c
	src/proto.c
	src/link.c
	src/wifi_msg.c
	src/msg_parse.c
	src/usage_view.c
	src/fmt.c
	src/cfg_store.c
	src/net_time.c
	src/ui_boot.c
	src/bootanim_dec.c
	src/bootclip.c
	src/ui_sleep.c
	src/sleep_gate.c
	src/upd_prompt.c
	src/ask_prompt.c
	src/upd_row.c
	src/upd_tap.c
	src/whatsnew.c
	src/logo_parse.c
	src/logo.c
	src/logo_write.c
	src/ui_settings.c
	src/edit_hold.c
	src/settings_icons.c
	src/ui_anim.c
	src/ui_slide.c
	src/ui_swipe.c
	src/backlight.c
	src/ota_parse.c
	src/ota.c
	src/ui_touchfx.c
	src/usage_state.c
	src/usage_freshness.c
	src/fatal.c
	src/fatal_policy.c
	src/svc_state.c
	src/theme.c
	src/font_focus_40.c
	src/ui_theme.c
	src/burn5h.c
)

# The radio's station half (spec S5.1); on in every image (Kconfig).
target_sources_ifdef(CONFIG_BLINK_WIFI_LINK app PRIVATE src/net_link.c
		     src/wl_server.c src/wl_hs.c src/wl_frame.c src/ota_net.c)

# Diagnostic only; CONFIG_BLINK_TOUCH_TRACE is off in release builds.
target_sources_ifdef(CONFIG_BLINK_TOUCH_TRACE app PRIVATE src/touch_trace.c)

# Bench only; CONFIG_BLINK_TOUCH_INJECT is off in every release build, and
# tools/lib_selftest.sh refuses an image that has it.
target_sources_ifdef(CONFIG_BLINK_TOUCH_INJECT app PRIVATE src/touch_inject.c
		     src/touch_widgets.c)


# The WiFi link's cipher (mbedTLS behind wl_crypto.h) and its boot
# self-test; CONFIG_BLINK_WIFI_LINK and the mbedTLS modules it needs come
# from firmware/Kconfig and prj.conf (spec S5.1).
target_sources_ifdef(CONFIG_BLINK_WIFI_LINK app PRIVATE src/wl_crypto_mbedtls.c)

# The [mem] lines (src/mem_stats.c), on whenever prj.conf keeps the heap
# counters on. It reads the LVGL pool's free lists through Zephyr's private
# lib/heap/heap.h, so ZEPHYR_BASE is on the path for this one file only and
# the file includes "lib/heap/heap.h" by that full name.
target_sources_ifdef(CONFIG_SYS_HEAP_RUNTIME_STATS app PRIVATE src/mem_stats.c)
set_source_files_properties(src/mem_stats.c PROPERTIES
	INCLUDE_DIRECTORIES ${ZEPHYR_BASE})
```

## Kconfig
```
# Application Kconfig. Zephyr sources this in place of its own root, so the
# trailing `source "Kconfig.zephyr"` is mandatory -- without it every upstream
# symbol disappears.

menu "Blink"

config BLINK_TOUCH_TRACE
	bool "Touch trace diagnostic"
	depends on INPUT_XPT2046
	help
	  Record every XPT2046 report into a RAM ring and dump it as CSV over
	  the console when the finger lifts. Diagnostic only -- enable via
	  trace.conf, never in a release build.

config BLINK_PANEL_PILOT
	bool "Build for the two pilot (POC) display panels"
	help
	  The production batch and the two pilot boards carry different
	  display modules. Measured on hardware 2026-08-21, the production
	  panels differ three ways: they render mirrored, they are wired RGB
	  where the ILI9341 driver hardcodes BGR, and their backlight is far
	  brighter at the same PWM duty. The firmware compensates for all
	  three by default, because production is what ships.

	  Set this when building for one of the two pilot boards, which need
	  none of that compensation and would otherwise come out mirrored,
	  colour-swapped and dim. Enable it through pilot.conf:

	    west build -b esp32_devkitc/esp32/procpu . -- \
	      -DEXTRA_CONF_FILE=pilot.conf

	  Deliberately NOT derived from flash encryption. The pilots happen to
	  be the only fused boards today, so keying off FLASH_CRYPT_CNT would
	  work right now and then quietly break: production units get fused
	  before shipping, and the rule would build pilot firmware for them.

config BLINK_BL_SCALE_PCT
	int "Backlight duty as a percent of the nominal level"
	range 10 100
	default 100 if BLINK_PANEL_PILOT
	default 60
	help
	  Scales every brightness step, so that a given user-facing percent
	  means the same amount of light on either batch. Compared side by
	  side at an identical setting, the production panel had to be
	  stepped down before it matched a pilot, so it is scaled here rather
	  than by lowering the default level -- which would have shrunk the
	  usable 20..100 range instead of recentring it.

config BLINK_FATAL_SELFTEST
	bool "Fault on purpose, to test the fatal handler on a board"
	help
	  Board test for src/fatal.c only. The firmware writes through a NULL
	  pointer from the system workqueue once it has been up
	  BLINK_FATAL_SELFTEST_AT_S seconds, on every boot, so the halt inside
	  the 30 s window, the reboot after it and the streak that halts the
	  fourth reboot can all be watched without hand-patching the source.
	  The boot log says SELFTEST BUILD.

	  Never in prj.conf or any .conf a release reads. Set it on the command
	  line, in a build directory of its own, because a -D value is kept in
	  that directory's CMake cache and a later plain build there would
	  still carry it:

	    west build --sysbuild -d build-selftest -b esp32_devkitc/esp32/procpu . -- \
	      -DSB_CONFIG_BOOTLOADER_MCUBOOT=y -DUSE_CCACHE=0 \
	      -DSB_CONFIG_BOOT_SIGNATURE_KEY_FILE="\"$HOME/.blink/ota_signing_key_p256.pem\"" \
	      -Dfirmware_CONFIG_BLINK_FATAL_SELFTEST=y \
	      -Dfirmware_CONFIG_BLINK_FATAL_SELFTEST_AT_S=60

	  then flash that directory, not build-sb:

	    BLINK_BUILD_DIR=$PWD/build-selftest ../tools/burn.sh --edition claude --no-build --selftest

	  (or --edition codex: the edition is stamped on the unit as on any
	  burn).

	  burn.sh refuses this build without --selftest, and release.sh and
	  flash_encrypted.sh refuse it outright (tools/lib_selftest.sh).

config BLINK_FATAL_SELFTEST_AT_S
	int "Uptime at which the selftest faults, in seconds"
	depends on BLINK_FATAL_SELFTEST
	range 1 3600
	default 60
	help
	  Under 30 to test the halt, over 30 to test the reboot.

config BLINK_TEST_NEVER_HEALTHY
	bool "Never report the image healthy (bench builds only)"
	help
	  BENCH BUILDS ONLY. NEVER SHIP THIS.

	  Never sets ota_health, so a test boot reaches its 90 s deadline and reverts.
	  Prints "[test] never healthy" at boot, so tools/lib_selftest.sh can refuse a release
	  that carries it (spec S9; the failure windows of a WiFi update that
	  nothing else can reach).

	  Set it on the command line, in a build directory of its own -- a -D
	  value stays in that directory's CMake cache, and a later plain build
	  there would still carry it. A bare -DBLINK_TEST_...=1 is a CMake
	  variable that reaches no CONFIG_ symbol:

	    west build --sysbuild -d build-test -b esp32_devkitc/esp32/procpu . -- \
	      -DSB_CONFIG_BOOTLOADER_MCUBOOT=y -DUSE_CCACHE=0 \
	      -DSB_CONFIG_BOOT_SIGNATURE_KEY_FILE="\"$HOME/.blink/ota_signing_key_p256.pem\"" \
	      -Dfirmware_CONFIG_BLINK_TEST_NEVER_HEALTHY=y

	  Grep the build's .config for the symbol and the console for the line
	  before every trial. release.sh refuses it.

config BLINK_TEST_CONFIRM_FAILS
	bool "Make the confirm call fail (bench builds only)"
	help
	  BENCH BUILDS ONLY. NEVER SHIP THIS.

	  boot_write_img_confirmed() reports failure, so the board logs [ota] confirm failed,
	  keeps the watchdog and retries until the deadline reverts it.
	  Prints "[test] confirm fails" at boot, so tools/lib_selftest.sh can refuse a release
	  that carries it (spec S9; the failure windows of a WiFi update that
	  nothing else can reach).

	  Set it on the command line, in a build directory of its own -- a -D
	  value stays in that directory's CMake cache, and a later plain build
	  there would still carry it. A bare -DBLINK_TEST_...=1 is a CMake
	  variable that reaches no CONFIG_ symbol:

	    west build --sysbuild -d build-test -b esp32_devkitc/esp32/procpu . -- \
	      -DSB_CONFIG_BOOTLOADER_MCUBOOT=y -DUSE_CCACHE=0 \
	      -DSB_CONFIG_BOOT_SIGNATURE_KEY_FILE="\"$HOME/.blink/ota_signing_key_p256.pem\"" \
	      -Dfirmware_CONFIG_BLINK_TEST_CONFIRM_FAILS=y

	  Grep the build's .config for the symbol and the console for the line
	  before every trial. release.sh refuses it.

config BLINK_TEST_HANG_AFTER_BOOT
	bool "Hang after the first panel (bench builds only)"
	help
	  BENCH BUILDS ONLY. NEVER SHIP THIS.

	  Spins with interrupts off once the first panel is up, so the watchdog
	  revert of an unconfirmed image is exercised.
	  Prints "[test] hang after boot" at boot, so tools/lib_selftest.sh can refuse a release
	  that carries it (spec S9; the failure windows of a WiFi update that
	  nothing else can reach).

	  Set it on the command line, in a build directory of its own -- a -D
	  value stays in that directory's CMake cache, and a later plain build
	  there would still carry it. A bare -DBLINK_TEST_...=1 is a CMake
	  variable that reaches no CONFIG_ symbol:

	    west build --sysbuild -d build-test -b esp32_devkitc/esp32/procpu . -- \
	      -DSB_CONFIG_BOOTLOADER_MCUBOOT=y -DUSE_CCACHE=0 \
	      -DSB_CONFIG_BOOT_SIGNATURE_KEY_FILE="\"$HOME/.blink/ota_signing_key_p256.pem\"" \
	      -Dfirmware_CONFIG_BLINK_TEST_HANG_AFTER_BOOT=y

	  Grep the build's .config for the symbol and the console for the line
	  before every trial. release.sh refuses it.

config BLINK_TOUCH_INJECT
	bool "Let the PC drive the touch panel (bench builds only)"
	depends on INPUT_XPT2046
	help
	  BENCH BUILDS ONLY. NEVER SHIP THIS.

	  Accepts {"t":"touch",...} lines over the cable and plays them into
	  the XPT2046's input device as panel reports, so LVGL and ui_swipe
	  both see a finger that is not there; answers {"t":"ui_state"}
	  with the screen and overlay on show; and answers {"t":"widgets"}
	  with every clickable control on the panel, popups included, so a
	  "click" by index taps any of them through the same input path
	  (src/touch_widgets.h). tools/board_touch.py drives it,
	  so every on-board interaction can be tested with nobody at the
	  panel (src/touch_inject.h has the wire). A shipped board with this
	  in it could be operated by anything on the computer it is plugged
	  into, so it is off by default and must stay out of prj.conf and of
	  every .conf a release reads. The boot log says INJECT BUILD.

	  Set it on the command line, in a build directory of its own -- a -D
	  value stays in that directory's CMake cache, and a later plain build
	  there would still carry it:

	    west build -p always --sysbuild -d build-inject \
	      -b esp32_devkitc/esp32/procpu . -- \
	      -DSB_CONFIG_BOOTLOADER_MCUBOOT=y -DUSE_CCACHE=0 \
	      -DSB_CONFIG_BOOT_SIGNATURE_KEY_FILE="\"$HOME/.blink/ota_signing_key_p256.pem\"" \
	      -Dfirmware_CONFIG_BLINK_TOUCH_INJECT=y

	  then flash that directory, not build-sb:

	    BLINK_BUILD_DIR=$PWD/build-inject ../tools/burn.sh --edition claude --no-build --bench

	  (or --edition codex: the edition is stamped on the unit as on any
	  burn). burn.sh refuses this build without --bench, and release.sh and
	  flash_encrypted.sh refuse it outright (tools/lib_selftest.sh).

config BLINK_WIFI_LINK
	bool "The WiFi link: the station half of the radio"
	depends on WIFI_ESP32 && NET_DHCPV4 && NET_MGMT_EVENT
	default y
	help
	  Scan, join and take the radio down again (src/net_link.c, spec
	  S5.1), for the encrypted WiFi link to the daemon. In every image:
	  the Phase 0 RAM gate passed with one image for all boards
	  (docs/research/2026-11-wifi-ram-spike.md, Verdict). The driver
	  initialises at boot either way; an unpaired board never brings the
	  interface up (D42).

	  Deliberately NOT the deleted BLINK_WIFI_MODE, the standalone mode
	  that fetched usage over the air. tools/release.sh still refuses a
	  build with that symbol set, and a new name keeps that guard meaning
	  what it says.

endmenu

# The deferred log carries every protocol line this board sends. It used to
# drop the OLDEST message when it was full; since prj.conf's
# LOG_BLOCK_IN_THREAD it drops nothing printed from a thread, and a writer
# that finds it full waits for the UART instead. So the size no longer
# decides whether a reply survives, only how long a burst the main thread
# can print before it has to wait.
#
# A bench image answers the PC far more often than a desk does -- a ui_state
# every 150 ms, a touch_done per stroke -- and the first board run of the
# widget image lost 22 of those replies behind whatever else was printed
# while a Settings transition held the main thread (src/touch_inject.c,
# touch_inject_service). It keeps 8 KB so the bench's timings stay what they
# were measured at.
#
# A release image goes from Zephyr's 1024 to 4096: 3 KB of the ~74 KB dram0
# has free (120632 of 196608 B used at 94d07db), for a boot or a slide
# printing four times as much before the panel waits on the wire.
config LOG_BUFFER_SIZE
	default 8192 if BLINK_TOUCH_INJECT
	default 4096

source "Kconfig.zephyr"
```

## sysbuild.conf
```
SB_CONFIG_BOOTLOADER_MCUBOOT=y
# ECDSA P-256 (tinycrypt), NOT ed25519: the ed25519 verifier (~20 KB of fiat
# curve25519 code) overflows the ESP32's fixed 40 KB bootloader iram_seg by
# ~10 KB -- it cannot link, in either swap mode. P-256 via tinycrypt fits with
# ~3.7 KB slack (sizing runs 2026-07-18; user-approved decision).
SB_CONFIG_BOOT_SIGNATURE_TYPE_ECDSA_P256=y
# The signing-key path is supplied at build time via
# -DSB_CONFIG_BOOT_SIGNATURE_KEY_FILE=... (sysbuild does not expand ~, and no
# local path should live in the tree). tools/release.sh passes it; for a manual
# build add e.g. -DSB_CONFIG_BOOT_SIGNATURE_KEY_FILE="$HOME/.blink/ota_signing_key_p256.pem".
# Swap with revert (NOT upgrade-only overwrite, which cannot roll back).
#
# swap-using-move, not swap-using-scratch. Scratch moves every sector through
# the scratch partition, so each sector is written three times, and on this
# flash-encrypted part every write is a read-modify-erase-write -- the swap
# took ~4-5 MINUTES of frozen screen for a 1.28 MB image (host-clock measured
# 2026-07-25; see the warning below about the bootloader's own timestamps).
# swap-move shifts the primary image up one sector and copies in place, with
# no scratch round-trip, so it moves substantially less data.
#
# WARNING for anyone measuring this: MCUboot's own log timestamps on this SoC
# are WRONG by roughly 15x -- it reported "16.9 s" for a swap that took 237+ s
# by the host clock, because the bootloader's millisecond counter is calibrated
# for a different CPU frequency than it actually runs at. Time swaps from
# outside the device, never from the "I (nnnnn)" prefixes.
#
# swap-move needs one spare sector in the primary slot (it shifts the image up
# to make room): slot 0x150000 - 4096 = 1372160 B usable vs a ~1.28 MB image.
# The scratch partition is left in the DT but is unused in this mode.
SB_CONFIG_MCUBOOT_MODE_SWAP_USING_MOVE=y
```

## prj.conf
```kconfig
# --- Console / logging ---
CONFIG_PRINTK=y
CONFIG_LOG=y
CONFIG_CBPRINTF_FP_SUPPORT=y

# Every line this board sends the daemon -- hello, pref, pong, theme_now,
# theme_edit, ota_query, ota_flash -- is a printk (proto.c emit()), and with
# LOG_PRINTK every printk is a message in Zephyr's deferred log, next to
# LVGL's warnings and every "[tag]" diagnostic. Zephyr's defaults made that
# buffer lossy in the worst direction: when it was full the OLDEST message
# was thrown away (LOG_MODE_OVERFLOW), and the thread that empties it runs
# at the lowest application priority, so it does nothing while the main
# thread is busy with a Settings slide or a panel build. A reply queued
# just before such a stretch was pushed out by whatever followed it, and
# neither side said so: the bench image, with an 8 KB buffer, lost 22
# replies in one board run that way (25912f7), and a release image has 1 KB.
# On a desk that is an Install or an "Edit on computer" tap that does
# nothing.
#
# So a thread no longer loses a line to the buffer. A thread that finds it
# full waits for room (LOG_BLOCK_IN_THREAD) instead of evicting someone
# else's line: the main thread pauses for as long as the UART needs to drain
# the backlog, at 115200 baud about 0.36 s for the whole 4 KB below, rather
# than losing a protocol line. Zephyr 4.3.1's mpsc_pbuf_alloc tries that wait
# before its drop path, so a waiting thread never evicts anything, whatever
# LOG_MODE_OVERFLOW says. The trigger threshold of 1 wakes the log thread on
# the first queued line instead of at its tenth or at a 1 s timer, so a
# waiting writer waits only for the UART and a lone reply leaves at the main
# loop's next sleep.
#
# Three cases can still lose a line, and Zephyr counts each one and prints
# "--- N messages dropped ---":
#   - a thread that waited the full 1000 ms with no progress, which means a
#     log thread that has stopped (it never waits for itself); one 512 B
#     line drains in about 45 ms;
#   - a message that cannot wait: interrupt context, or interrupts locked.
#     No line in firmware/src is printed either way;
#   - the fault path, which is exactly that kind of writer: z_fatal_error
#     takes arch_irq_lock() before ">>> ZEPHYR FATAL ERROR", and the Xtensa
#     register dump (PC, EXCCAUSE, A0-A15) runs in exception context, both
#     before LOG_PANIC flushes the buffer.
# For those LOG_MODE_OVERFLOW stays at Zephyr's default, which drops the
# OLDEST queued line. It was turned off in 10bf7b4, and with a buffer full
# of LVGL's pool warnings a crash dump would then have been refused line by
# line: the one field fault this release worries about most would have lost
# the line that says where it was (fp/fix-fwlog review, S1). Evicting the
# oldest line is right only there, and only there does it happen.
#
# Why not a separate, direct UART writer for protocol lines: the log thread
# writes a line a byte at a time with uart_poll_out and is preempted mid-line
# whenever the main thread wakes, so a direct write would land inside half a
# diagnostic line and the daemon, which wants "{" first, would drop the
# reply anyway. Kept in one queue, every line comes out whole and in order.
#
# LVGL keeps logging at WARN, deliberately: the pool-exhaustion warnings,
# lv_draw_buf_create_ex's "No memory" and "Allocating layer buffer failed",
# are LV_LOG_WARN in LVGL 9 (lv_draw_buf.c, lv_draw.c), and they are what
# says the 30 KB pool ran dry before the board faults. With a thread's lines
# no longer evicted, they cost the panel time, not replies.
CONFIG_LOG_BLOCK_IN_THREAD=y
CONFIG_LOG_BLOCK_IN_THREAD_TIMEOUT_MS=1000
CONFIG_LOG_PROCESS_TRIGGER_THRESHOLD=1

# --- Console UART access for protocol I/O ---
CONFIG_SERIAL=y
CONFIG_UART_CONSOLE=y
CONFIG_CONSOLE=y

# Interrupt-driven RX. On a real UART (this board, unlike the C6's USB-CDC) the
# 128-byte FIFO holds ~11 ms at 115200 baud, so polling from the main loop drops
# bytes mid-line as soon as anything stalls it.
CONFIG_UART_INTERRUPT_DRIVEN=y
CONFIG_RING_BUFFER=y

# --- Board identity for the hello message ---
CONFIG_HWINFO=y

# --- Heap / stacks ---
CONFIG_MAIN_STACK_SIZE=8192
# CONFIG_NET_SOCKETS_SERVICE_STACK_SIZE=4096 lived here for the SoftAP's DHCP
# server, whose 2400 B default stack overflowed (2026-07-24). The radio and
# the IP stack left the image on 2026-10-27, and the line only made every
# build warn that NET_SOCKETS_SERVICE, NET_SOCKETS and NETWORKING are off.
# Gone, so that a new warning in the build log gets noticed; git history has
# the story.
# Cheap insurance: turn a future stack overflow into a clean named reboot instead
# of silent memory corruption. THREAD_NAME makes the culprit legible in the dump.
CONFIG_THREAD_NAME=y
CONFIG_STACK_SENTINEL=y

# --- Display bring-up (CYD-T2 panel probe) ---
CONFIG_SPI=y
# Explicitly OFF, which is also the Kconfig default -- kept as a line rather
# than a deletion so nobody re-adds it for the reason we did.
#
# It was set on 2026-07-27 to "sleep on the transfer-complete interrupt instead
# of busy-polling". The driver does not do that. With it on, transceive() arms
# the interrupt and falls straight through to spi_context_release() --
# spi_esp32_spim.c has no spi_context_wait_for_completion() call, and
# CONFIG_SPI_ASYNC is off, so the spi_context_complete() the ISR performs only
# gives a semaphore nobody takes. Every synchronous transfer became
# fire-and-forget: XPT2046 read its RX buffer before the words landed (16
# averaged reads per touch report), and display_write() returned with DMA still
# reading the caller's strip.
#
# The busy-poll it was meant to remove survives either way -- the
# `while (!spi_hal_usr_is_done(hal))` spin is still there, just moved into the
# ISR. And that ISR is registered ESP_INTR_FLAG_IRAM while its CS teardown
# reaches gpio_esp32_port_clear_bits_raw in .flash.text, so it would fault if it
# fired during an NVS or OTA write, when the flash cache is down.
CONFIG_SPI_ESP32_INTERRUPT=n
CONFIG_GPIO=y
CONFIG_DISPLAY=y
CONFIG_MIPI_DBI=y
CONFIG_ILI9341=y
CONFIG_INPUT=y
CONFIG_INPUT_XPT2046=y

# --- LVGL ---
CONFIG_LVGL=y
CONFIG_LV_USE_LOG=y
CONFIG_LV_COLOR_DEPTH_16=y
# The ILI9341 takes big-endian RGB565 over SPI; the ESP32 is little-endian.
CONFIG_LV_COLOR_16_SWAP=y
# 32 KiB: gauge screen + settings overlay + confirm dialog coexist, and every
# redraw allocates transient draw tasks on top. 16 KiB ran dry there and LVGL
# NULL-derefed (no graceful malloc-failure path in lv_draw_add_task).
#
# Back to 32768 from 30720 (2026-10-28). The 2 KB had gone to the enlarged
# net_socket_service stack, which shared dram1 with this pool, and that stack
# left with the radio. The 30720 had been called "ample headroom" without a
# measurement, and the measurement disagreed: popups_touch peaked at 28312 B
# of the 30632 usable on the bench board (2320 B left). A failed-check notice
# landing on top of the install confirm -- reachable while Settings sits on
# "Install version X?" and the app stops answering -- measured +4632 B over
# Settings on the host harness, which maps to 0.65-1.3 KB left on the board
# (full review #2, M1; scratchpad rv2-mem). The confirm is now also taken down
# when the offer lapses (ui_settings.c, upd_timer_cb), so that stack should not
# form at all; this is the margin for whatever does.
#
# The pool is .noinit.lvgl_pool in dram1 (0x3ffeb800). dram1 is 98304 B and
# held 55556 B at f107c0c, so 42748 B were free before this 2048. The usable
# pool is 32680 B: the heap keeps the same 88 B of metadata as at 30720, since
# both sizes need twelve buckets (tools/board_touch.py, POOL_USABLE).
CONFIG_LV_Z_MEM_POOL_SIZE=32768
# Nobody had measured that headroom. gapietro's fork did, for its own 30 KB
# pool, whose settings panel had one more row than ours: on 2026-10-14 it
# stood at 23504 B used and 7128 B free just before the panel was drawn --
# and the draw exhausted it and halted the board. Hence the runtime
# stats: the board reports this pool on every screen change, as a
# "[mem] lvgl ..." line in bridge.log (fields explained in
# src/mem_stats.c). With the option off, lvgl_heap_stats() has
# no counters to read and reports nothing. The price is 16 B per heap (12 B
# of counters in 8-byte chunks) plus a few instructions per malloc/free.
# The heap array is how mem_stats.c reaches LVGL's heap, which the Zephyr
# module declares static; 8 slots is more than this image has heaps.
CONFIG_SYS_HEAP_RUNTIME_STATS=y
CONFIG_SYS_HEAP_ARRAY_SIZE=8
# dram0 is full (growing the pool past 16 KiB fails to link), but dram1 has
# ~46 KiB spare behind the noinit output section. A .noinit.* section name
# routes the pool there; sys_heap_init formats it, so no zero-init needed.
CONFIG_LV_Z_MEMORY_POOL_ZEPHYR_REGION=y
CONFIG_LV_Z_MEMORY_POOL_ZEPHYR_REGION_NAME=".noinit.lvgl_pool"
# The resistive panel's contact bounce fires a burst of INT edges at touch
# down/up, each producing a full XPT2046 report; a burst can exceed the queue
# within one 10 ms LVGL cycle and drop the button press/release -> missed taps
# (seen on hardware 2026-07-18: a single touch dropped dozens of events).
# The LVGL glue drains the whole msgq every lv_timer_handler pass
# (continue_reading), so a deeper queue only absorbs the burst -- no latency.
# DRAM is nearly full (256 overflowed dram1 by 14 KB, 128 by 2.8 KB): 96 is
# the most that fits, a 50% bump. A driver-level debounce is the real fix if
# this still drops.
CONFIG_INPUT_QUEUE_MAX_MSGS=96
CONFIG_LV_Z_POINTER_INPUT_MSGQ_COUNT=96
# Partial rendering, NOT a 150 KB framebuffer: this module has no PSRAM, so
# a whole-screen buffer would have to come out of the chip's 520 KB of SRAM,
# which the rest of the firmware already shares.
#
# The buffer is 12288 B, not the 6144 this comment used to claim. LV_Z_VDB_SIZE
# is a percentage of the screen, but the Zephyr glue turns it into bytes with
# LV_Z_BITS_PER_PIXEL (modules/lvgl/lvgl.c, BUFFER_SIZE), and that Kconfig lists
# an unconditional `default 32` BEFORE `default 16 if LV_COLOR_DEPTH_16` --
# first default wins, so it is 32 here despite our 16-bit colour.
# 32 * (4 * 320 * 240 / 100) / 8 = 12288, confirmed as .bss.buf0_0 = 0x3000.
#
# Nearly all of it is used: the full byte count goes to lv_display_set_buffers,
# which floors it to whole rows (12288 / 640 B stride = 19 rows), so LVGL renders
# 6080 RGB565 pixels per pass -- 8% of the screen, and ~13 render-and-flush passes
# for a full redraw, not 25. The ~128 B remainder is the row-alignment offcut.
#
# Setting CONFIG_LV_Z_BITS_PER_PIXEL=16 would make the number mean what it says
# and hand ~6 KB back, which is worth remembering: measured 2026-07-26, free
# DRAM is ~3.3 KB in dram0 (__bss_end 0x3ffdf300 vs heap sentry 0x3ffe0000)
# plus ~0.4 KB in dram1. It would also halve the flush chunk and double the
# pass count, so it is a lever for when DRAM gets tight, not a fix.
CONFIG_LV_Z_VDB_SIZE=4
# LVGL's own frame gate. The default 33 ms caps everything at 30 FPS, which is
# irrelevant to a full-screen redraw (124 ms, bounded elsewhere) but does bind
# on the cheap partial redraws, which measure ~5 ms.
#
# 16 does NOT buy a 16 ms period. The repeating lv_timer_handler() call sites
# here sit in loops that sleep between passes -- run_usb() in main.c sleeps
# 10 ms, ui_anim.c and ui_boot's clip playback 5 ms each -- so LVGL
# is never asked to refresh more often than that, and a 16 ms gate lands on
# the first pass that crosses it: ~20 ms either way. Real, but half what the
# number suggests.
#
# It does nothing for the countdown digits: usage_view_tick_1s() is called
# behind a `now - last_tick >= 1000` guard, so that text changes at 1 Hz no
# matter what this is set to.
CONFIG_LV_DEF_REFR_PERIOD=16
CONFIG_LV_USE_ARC=y
CONFIG_LV_USE_SPINNER=y
CONFIG_LV_USE_BUTTON=y
CONFIG_LV_USE_LABEL=y
CONFIG_LV_FONT_MONTSERRAT_20=y
CONFIG_LV_Z_POINTER_INPUT=y

# --- The WiFi link (spec S5.1; src/net_link.c, CONFIG_BLINK_WIFI_LINK) ---
#
# The radio came back on 2026-11-06 for one thing only: an encrypted link to
# the daemon on the owner's own network, instead of the cable. No TLS, DNS,
# HTTP, SNTP or SoftAP -- the deleted standalone mode (2026-10-27) had all of
# those, and the board still gets usage, the time and firmware only from the
# daemon. The Phase 0 RAM gate measured exactly this block on the bench board
# and passed it as one image for every board
# (docs/research/2026-11-wifi-ram-spike.md, "Verdict"; spike/wifi-ram).
#
# Dormant means the interface, not the driver (D42): with CONFIG_WIFI=y the
# driver's device initialiser runs esp_wifi_init() at boot on every board,
# paired or not, and its allocations come out of the heap below. What waits
# is net_if_up() -- the RF, DHCP and the sockets -- which an unpaired board
# never calls. That cost (driver initialised, interface down) is the spike's
# "unpaired" row.
CONFIG_WIFI=y
CONFIG_WIFI_ESP32=y
CONFIG_NETWORKING=y
CONFIG_NET_IPV4=y
# One IPv4 address on one station interface; v6 is RAM for nothing on a LAN
# link the daemon finds by IPv4 broadcast (S5.6).
CONFIG_NET_IPV6=n
# The client only. The SoftAP's server is gone with the SoftAP.
CONFIG_NET_DHCPV4=y
# net_link.c reads the driver's connect result as "address bound": with this
# on, the driver raises it at DHCP_BOUND (esp_wifi_drv.c:83), not at
# association. It is the default with NET_DHCPV4; pinned because net_link.c
# BUILD_ASSERTs it.
CONFIG_ESP32_WIFI_STA_AUTO_DHCPV4=y
# The session (TCP 49731) and the discovery responder (UDP 49731, D18).
CONFIG_NET_TCP=y
CONFIG_NET_UDP=y
CONFIG_NET_SOCKETS=y
# The connect, disconnect and scan events net_link.c waits on.
CONFIG_NET_MGMT=y
CONFIG_NET_MGMT_EVENT=y
CONFIG_NET_CONTEXT_RCVTIMEO=y
CONFIG_NET_CONTEXT_SNDTIMEO=y
# Aggregation is a throughput feature for a link that carries a few frames a
# second, and each BlockAck session's reorder queue comes out of the heap.
CONFIG_ESP32_WIFI_AMPDU_TX_ENABLED=n
CONFIG_ESP32_WIFI_AMPDU_RX_ENABLED=n
# The brownout cap the old WiFi build measured on this board's supply. The
# 30-minute run on a phone charger at 11 dBm (S11) is still the owner's, and
# is due before feat/wifi-transport merges.
CONFIG_ESP32_PHY_MAX_TX_POWER=11

# The old wifi.conf's counts, sized for a SoftAP serving a portal page. S11
# lists trimming them as the first lever, and RAM passed the gate without any
# lever (heap low-water 38120 B free, dram1 12276 B free), so they stand as
# measured.
CONFIG_NET_BUF_RX_COUNT=28
CONFIG_NET_BUF_TX_COUNT=40
CONFIG_NET_PKT_RX_COUNT=14
CONFIG_NET_PKT_TX_COUNT=16

# Found by the spike, not levers: at Zephyr's defaults (4 and 3) the
# replacement session (D29) was answered with a reset at connect.
# NET_MAX_CONN counts every connection handler: DHCP's client on 68, the UDP
# responder, the TCP listener and the live session fill four, so the
# candidate needs a fifth, plus one for a replaced session still in
# TIME_WAIT (1.5 s).
CONFIG_NET_MAX_CONN=6
# zvfs_poll() takes at most this many entries, and the network thread polls
# four (listener, responder, candidate, session) while a replacement is
# under way.
CONFIG_ZVFS_POLL_MAX=4

# The handshake and the frame cipher (S6.2, S6.3): ChaCha20-Poly1305 and
# HKDF-SHA256 from mbedTLS 3.6.6, symbols checked in the 4.3.1 workspace
# (zephyr/modules/mbedtls/Kconfig.mbedtls). Still no TLS.
CONFIG_MBEDTLS_CIPHER_CHACHA20_ENABLED=y
CONFIG_MBEDTLS_POLY1305=y
CONFIG_MBEDTLS_CHACHAPOLY_AEAD_ENABLED=y
CONFIG_MBEDTLS_HKDF_C=y
CONFIG_MBEDTLS_MD_C=y
CONFIG_MBEDTLS_SHA256=y
# sys_csrand_get, for the handshake's nonces. CSPRNG_ENABLED has no prompt in
# 4.3.1 (subsys/random/Kconfig:96): it follows ENTROPY_HAS_DRIVER on its own,
# so only the generator is set. The ESP32's RNG is a true RNG only while the
# RF is on, which it is whenever a nonce is drawn.
CONFIG_ENTROPY_GENERATOR=y

# Two stacks the gate's "every thread below 75 %" failed as built, each
# raised alone and re-measured (S11's 2026-11-06 note admits stack sizes as
# levers). 512 B of dram1 each.
#
# The deferred-log thread: 964 of 1024 B (94 %) on the spike and 916 (89 %)
# on the plain release image with no radio at all, so this was over the line
# before WiFi. 62 % at 1536.
CONFIG_LOG_PROCESS_THREAD_STACK_SIZE=1536
# The system work queue, which the driver and the net stack queue work on:
# 308 B on the plain image, 804 of 1024 (78 %) once the radio is up and after
# a rejoin. 52 % at 1536. net_link.c keeps its own blocking join off it.
CONFIG_SYSTEM_WORKQUEUE_STACK_SIZE=1536

# --- Config store, and the bits the display path needs ---
#
# These sat inside the old "Networking" block and moved out with it, which
# broke a USB-only build in ways that had nothing to do with the radio:
# IMG_MANAGER (OTA) depends on FLASH_MAP, and the backlight is a PWM. Every
# image needs them, radio or none.
#
# cfg_store is NOT settings/NVS: NVS needs erased flash to read as 0xFF, and
# with flash encryption on, erased sectors read as decrypt-garbage. It keeps
# its own A/B CRC-sealed record in the storage partition instead.
CONFIG_FLASH=y
CONFIG_FLASH_MAP=y
CONFIG_CRC=y
CONFIG_REBOOT=y
CONFIG_PWM=y
CONFIG_ESP_FLASH_ENCRYPTION=y
# logo_chunk lines carry the logo's bytes as base64 over the cable (spec
# S15.2, proto.c logo_chunk_line): Zephyr's decoder, not one of our own.
CONFIG_BASE64=y
# CONFIG_ZVFS_OPEN_MAX=16 sat here from the WiFi build's sockets; ZVFS is off
# without them, so it only made every build warn. Removed 2026-10-28. The
# WiFi link's sockets brought ZVFS back on 2026-11-06 and still need no line
# here: the net stack adds its own six descriptors (ZVFS_OPEN_ADD_SIZE_NET,
# from NET_MAX_CONTEXTS), which is what the spike ran on.
CONFIG_LV_FONT_MONTSERRAT_14=y
CONFIG_LV_FONT_MONTSERRAT_16=y
# Sized for the old WiFi build, where the driver and mbedTLS shared this
# pool, and the driver is back on it (the WiFi link above). The Phase 0 gate
# measured it before anyone touched it: low-water 38120 B free across join,
# scan, a ten-minute session, a replacement and a 1.3 MB OTA stream, largest
# chunk within 100 B of free at both instrumented low-water points. S11's
# lever list says right-size it from that number; RAM passed without it, so
# it stands. Too small shows up as an allocation failure deep in the driver,
# not as a build error.
CONFIG_HEAP_MEM_POOL_SIZE=86016

# --- Hashing for the OTA image check ---
#
# NOT a TLS stack -- there is none. ota.c verifies a streamed image against
# the manifest's sha256, and main.c routes mbedTLS's allocator at the kernel
# heap; both need mbedTLS present, neither needs a handshake. A hash brings no
# client id, no certificate and no network.
CONFIG_MBEDTLS=y
CONFIG_MBEDTLS_BUILTIN=y

# --- OTA: image management + slot1 streaming ---
CONFIG_IMG_MANAGER=y
CONFIG_MCUBOOT_BOOTUTIL_LIB=y
CONFIG_STREAM_FLASH=y
CONFIG_IMG_ERASE_PROGRESSIVELY=y
CONFIG_LV_USE_BAR=y
# OTA test boots arm the hardware watchdog: a hard-hung update image stops
# feeding, the chip resets, and MCUboot reverts to the previous version.
CONFIG_WATCHDOG=y
```

## pilot.conf
```kconfig
# Build for one of the two pilot (POC) boards rather than the production batch.
#
#   west build -b esp32_devkitc/esp32/procpu . -- -DEXTRA_CONF_FILE=pilot.conf
#
# Their display modules differ: see BLINK_PANEL_PILOT in Kconfig. Flashing a
# stock (production) build to a pilot leaves it mirrored, red/blue swapped and
# dim -- and the reverse is equally wrong, so pick deliberately, per board.
CONFIG_BLINK_PANEL_PILOT=y
```

## trace.conf
```kconfig
# Touch-trace diagnostic build. Layered on prj.conf via
# -Dfirmware_EXTRA_CONF_FILE=trace.conf; pair with trace.overlay.
CONFIG_BLINK_TOUCH_TRACE=y

# The dump printk()s from the input thread, whose default 1024 B stack is sized
# for callbacks that only forward events.
CONFIG_INPUT_THREAD_STACK_SIZE=2048

# This file used to cut the LVGL pool to 27648, because the tracer's 1.5 KB
# ring and the bigger input stack overflowed dram1 by 612 B when the WiFi
# build had it ~99% full. dram1 has had ~40 KB free since the radio went, and
# a trace build at the release pool's 32768 uses 58628 of its 98304 B. The
# cut had become the bug: 27560 B usable is below what the board is measured
# to use opening Theme (27600) or a popup over Settings (28312), so a trace
# build ran dry, wrote through NULL and rebooted in the middle of the very
# trace it exists for (fp/pool review, S1). The pool is prj.conf's alone now,
# which tests/test_mem_stats_line.py pins for every overlay.
```

## wifi.conf
```kconfig
# Standalone WiFi mode: the board fetches its own usage over the air.
#
# NOT part of a default build. Everything here exists to support
# CONFIG_BLINK_WIFI_MODE, which is default n -- see firmware/Kconfig for why.
# Enable the whole thing with:
#
#   west build --sysbuild -d build-sb -b esp32_devkitc/esp32/procpu . \
#     -- -DEXTRA_CONF_FILE=wifi.conf
#
# Keep this file and the Kconfig symbol in step: the symbol decides which
# SOURCES compile, this decides which Zephyr subsystems exist for them to call.
CONFIG_BLINK_WIFI_MODE=y

# --- Networking: WiFi + TLS (standalone mode) ---
CONFIG_WIFI=y
CONFIG_WIFI_ESP32=y
# Without AP_STA_MODE the driver never creates a soft-AP net_if: the AP
# broadcasts, a phone associates, and then nothing answers its DHCP request --
# it just spins on "obtaining IP address" forever. Requires the WiFi network
# manager.
CONFIG_ESP32_WIFI_AP_STA_MODE=y
CONFIG_WIFI_NM=y
CONFIG_WIFI_NM_MAX_MANAGED_INTERFACES=2
# Defense-in-depth for the tight WiFi/system heap: a station associating to the
# SoftAP opens a BlockAck session whose RX_BA_WIN-sized reorder queue is allocated
# from that heap. AMPDU aggregation is a pure-throughput feature this once-a-minute
# usage display never needs, so turning it off drops that per-station allocation
# and eases heap pressure. (The actual join crash was a net_socket_service stack
# overflow + heap OOM, fixed above/below; this just keeps more slack.)
CONFIG_ESP32_WIFI_AMPDU_TX_ENABLED=n
CONFIG_ESP32_WIFI_AMPDU_RX_ENABLED=n
CONFIG_NETWORKING=y
CONFIG_NET_IPV4=y
# Two interfaces (station + soft-AP) means two IPv4 contexts. This defaults to
# 1, and with only one the AP interface silently fails to take an address --
# net_if_ipv4_addr_add() just returns NULL.
CONFIG_NET_IF_MAX_IPV4_COUNT=2
CONFIG_NET_IPV6=n
CONFIG_NET_DHCPV4=y
CONFIG_NET_DHCPV4_SERVER=y
# Hand out OURSELVES as the DNS server. Zephyr's default points somewhere else
# entirely, and with the wrong DNS the phone's captive-portal probe never
# reaches us: the OS decides "no internet" instead of "behind a portal" and
# quietly falls back to cellular without ever showing the setup page.
CONFIG_NET_DHCPV4_SERVER_OPTION_DNS_ADDRESS="192.168.4.1"
# Send the router (default gateway) option. OFF by default, but iOS REFUSES a
# DHCP lease that has no router option and spins on "obtaining IP" forever --
# macOS accepts it, which is why the Mac got an address and the iPhone did not.
CONFIG_NET_DHCPV4_SERVER_OPTION_ROUTER=y
# iOS usually does NOT set the DHCP broadcast flag, so the server unicasts its
# OFFER to the phone's MAC and must inject an ARP entry to do it. The default
# ARP table holds only 2 entries -- too small to reliably keep that mapping.
CONFIG_NET_ARP_TABLE_SIZE=16
# Kill the pre-offer ICMP probe: it adds a 1s stall per offer (long enough for
# iOS's DHCP client to give up and retry) and buys us nothing on a private
# 8-address pool we fully control.
CONFIG_NET_DHCPV4_SERVER_ICMP_PROBE_TIMEOUT=0
# Bigger pool + short lease. Phones use a ROTATING private MAC, so every
# "forget and rejoin" during setup looks like a brand-new client. With the
# default of 4 addresses and a 24h lease, a few retries exhaust the pool and
# the board stops offering addresses -- the phone then just spins on
# "obtaining IP". A short lease lets stale reservations expire in minutes.
CONFIG_NET_DHCPV4_SERVER_ADDR_COUNT=8
CONFIG_NET_DHCPV4_SERVER_ADDR_LEASE_TIME=300
CONFIG_NET_TCP=y
CONFIG_NET_SOCKETS=y
# Connection/fd budget. Defaults are too small for what we run concurrently:
# the DHCP server, the DNS hijack socket, the TCP listener AND an accepted
# connection all need slots. At the default NET_MAX_CONN=4 incoming TCP is
# simply dropped -- ping works, HTTP does not.
CONFIG_NET_MAX_CONN=8
CONFIG_NET_MAX_CONTEXTS=10
CONFIG_ZVFS_OPEN_MAX=16
CONFIG_NET_SOCKETS_POLL_MAX=4
CONFIG_NET_SOCKETS_SOCKOPT_TLS=y
CONFIG_NET_L2_ETHERNET=y
# NOT NET_CONFIG_SETTINGS/AUTO_INIT: it blocks at boot waiting for the iface to
# acquire an IPv4 address, which never happens before we have credentials -- it
# stalled main() entirely. We bring WiFi up ourselves.
CONFIG_NET_CONFIG_SETTINGS=y
CONFIG_NET_CONFIG_AUTO_INIT=n
CONFIG_NET_MGMT=y
CONFIG_NET_MGMT_EVENT=y
CONFIG_DNS_RESOLVER=y
CONFIG_SNTP=y

# --- TLS ---
CONFIG_MBEDTLS=y
CONFIG_MBEDTLS_BUILTIN=y
# NOT the Zephyr static heap. CONFIG_MBEDTLS_ENABLE_HEAP=y reserves
# `static unsigned char _mbedtls_heap[CONFIG_MBEDTLS_HEAP_SIZE]`
# (modules/mbedtls/zephyr_init.c:37) for TLS whether TLS is running or not,
# while HEAP_MEM_POOL_SIZE separately reserves a worst case for WiFi. Two
# static worst cases do not fit on this chip: ~6 KB was free across dram0+dram1
# with mbedTLS at 32000, which is too little for the OTA download's 16 KB
# record buffer AND the release CDN's all-RSA certificate chain.
#
# The two peaks never coincide -- TLS is idle during provisioning, and the
# SoftAP is down in standalone mode when OTA runs -- so main.c points mbedTLS
# at the kernel heap (mbedtls_platform_set_calloc_free) and ONE pool sized to
# the larger peak replaces two sized to their sum.
#
# With ENABLE_HEAP=n, mbedTLS would otherwise fall back to libc calloc, and
# picolibc's heap here is ~5 KB ("libc heap size 5 kB" at boot) -- far too
# small. main.c's override is therefore load-bearing, not an optimisation.
CONFIG_MBEDTLS_ENABLE_HEAP=n
# Unused while ENABLE_HEAP=n (no static _mbedtls_heap is allocated); kept so a
# future revert to the static heap does not silently land on the Kconfig
# default. History, since it cost real hardware time to establish: with the
# static heap and pool at 55296, 32000 truncated the release CDN's all-RSA
# chain mid-parse (update check failed x509 -0x2700), 36000 linked but
# misbehaved (bogus HTTP status 618), and 40000 -- the smallest value that
# actually worked -- did not fit at all, overflowing dram0 by 1968 B.
CONFIG_MBEDTLS_HEAP_SIZE=32000
# Baseline for both record buffers, but src/mbedtls_user_config.h OVERRIDES
# them asymmetrically (IN=16384, OUT=2048). Zephyr maps this one symbol to
# both MBEDTLS_SSL_IN_CONTENT_LEN and _OUT_CONTENT_LEN, and inbound has to be
# 16384 -- the TLS maximum -- because GitHub's release CDN ramps to full-size
# records once a download passes ~32 KB. Outbound never needs more than a GET.
CONFIG_MBEDTLS_SSL_MAX_CONTENT_LEN=6144
CONFIG_MBEDTLS_USER_CONFIG_ENABLE=y
CONFIG_MBEDTLS_USER_CONFIG_FILE="mbedtls_user_config.h"
# Config store: NOT settings/NVS. NVS needs erased flash to read as 0xFF,
# and with flash encryption enabled erased sectors read as decrypt-garbage
# (mount died with -EDEADLK on hardware, 2026-07-17; ESP-IDF exempts NVS
# from flash encryption for the same reason). cfg_store keeps its own A/B
# CRC-sealed record in the storage partition instead -- garbage-means-empty
# is by design there. CRC for the record seal.
CONFIG_FLASH=y
CONFIG_FLASH_MAP=y
CONFIG_CRC=y
# This IS the heap the ESP32 WiFi driver allocates from (k_malloc-backed
# _system_heap; the esp heap_caps path is a stub here). A phone associating to
# the SoftAP allocates per-station buffers from it, and provisioning idle left
# only ~8.8 KB free -- the alloc failed ("esp32_wifi_adapter: memory allocation
# failed") and the driver then corrupted kernel memory into a fatal z_swap crash
# (measured 2026-07-24).
#
# The effective pool size is max(this, sum of HEAP_MEM_POOL_ADD_SIZE_* floors).
# The WiFi(40 KB)+board(4 KB)+getaddrinfo adds already floor it at ~45 KB, so any
# value below that (the old 16384) does NOTHING. Set ABOVE the floor to actually
# grow it: 55296 bought ~10 KB of real headroom (free ~8.8 -> ~19 KB), plenty for
# a station join (measured dipping only to ~17 KB).
#
# Since ENABLE_HEAP=n this pool is now ALSO the mbedTLS heap (main.c routes
# mbedtls_calloc here), so it must additionally cover a TLS session: an 16 KB
# inbound record buffer + 2 KB outbound + the peer certificate chain, ~20-25 KB
# for the OTA download, which is the heaviest user. Sized for the larger of the
# two peaks rather than their sum, which is the whole point -- they never
# overlap, as the SoftAP is down whenever OTA runs. 86016 replaces the old
# 55296 + 32000 static pair and still leaves dram0 headroom.
CONFIG_HEAP_MEM_POOL_SIZE=86016
# Packet pools. Trimmed once to 8/16 to save DRAM -- that was too far: a phone
# joining the SoftAP sprays small mDNS/discovery packets, the RX pool drains,
# and the TCP stack freezes at ESTABLISHED and never recovers (the known
# failure mode of zephyr#45426 / #55671: allocation stalls inside the stack).
# Verified on this hardware: handshake completed, then the whole RX path died.
# RX-heavy on purpose; inbound flood is the pressure source.
CONFIG_NET_BUF_RX_COUNT=28
# TX pool sized so a retransmission can ALWAYS allocate: Zephyr TCP clones
# the segment on resend, and with a ~2 KB portal page pinning 16 of 20 bufs a
# single frame lost on air could never be retransmitted -- the stack logged
# "TCP failed to allocate buffer in retransmission" and killed the
# connection (root cause of the captive-portal white pages, 2026-07-16).
CONFIG_NET_BUF_TX_COUNT=40
CONFIG_NET_PKT_RX_COUNT=14
CONFIG_NET_PKT_TX_COUNT=16
CONFIG_LV_USE_QRCODE=y
CONFIG_LV_USE_TEXTAREA=y
CONFIG_LV_FONT_MONTSERRAT_14=y
CONFIG_LV_FONT_MONTSERRAT_16=y
# --- HTTP client for OAuth token calls + usage fetch ---
CONFIG_HTTP_CLIENT=y
CONFIG_DNS_RESOLVER=y
CONFIG_REBOOT=y



# This board's 3.3V rail sags under full-power radio bursts (observed:
# POWERON_RESETs at the moment a station associates, join handshakes timing
# out while scans work, and occasional boots with a blind radio). 11 dBm
# roughly quarters the peak PA current vs 20 dBm and is plenty for same-room
# provisioning and home-router range.
CONFIG_ESP32_PHY_MAX_TX_POWER=11

# Make SO_SNDTIMEO real: without this a UDP sendto blocks forever on buffer
# starvation, which is how the DNS hijack thread got wedged (its teardown
# then needs k_thread_abort and leaks the socket).
CONFIG_NET_CONTEXT_SNDTIMEO=y
# Same story for SO_RCVTIMEO: tz_fetch sets an 8 s recv timeout that was
# silently a no-op without this -- a stalled HTTP server would park the whole
# standalone loop (UI included) in recv() forever.
CONFIG_NET_CONTEXT_RCVTIMEO=y
# The default 3 s connect budget is a razor edge for TLS over a cellular
# hotspot: higher RTT, a ~6 KB certificate flight in 536-byte segments (MTU
# 576), and 1-2 s of ECDHE math on this CPU. The OAuth exchange timed out
# with -116 twice on an iPhone hotspot (2026-07-15) while the same exchange
# passed on hotel WiFi.
CONFIG_NET_SOCKETS_CONNECT_TIMEOUT=20000

# Both Anthropic endpoints serve all-ECDSA chains (P-384 roots, SHA-384
# signatures) behind CDNs that only offer ECDHE + AEAD suites. Without these,
# every TLS handshake fails at connect() -- discovered the first time the
# OAuth exchange ran on hardware (2026-07-14).
CONFIG_MBEDTLS_ECP_C=y
CONFIG_MBEDTLS_ECDH_C=y
CONFIG_MBEDTLS_ECDSA_C=y
CONFIG_MBEDTLS_ECP_DP_SECP256R1_ENABLED=y
CONFIG_MBEDTLS_ECP_DP_SECP384R1_ENABLED=y
CONFIG_MBEDTLS_ECP_DP_CURVE25519_ENABLED=y
CONFIG_MBEDTLS_KEY_EXCHANGE_ECDHE_ECDSA_ENABLED=y
CONFIG_MBEDTLS_KEY_EXCHANGE_ECDHE_RSA_ENABLED=y
CONFIG_MBEDTLS_SHA384=y
CONFIG_MBEDTLS_CIPHER_GCM_ENABLED=y

# TEMPORARY diagnostics: mbedTLS handshake tracing for the -113 abort.
CONFIG_MBEDTLS_DEBUG=y
CONFIG_MBEDTLS_LOG_LEVEL_ERR=y

# Send SNI in the ClientHello. Compiled out, mbedTLS keeps the hostname only
# for local cert checks; Cloudflare-fronted hosts (console.anthropic.com)
# refuse SNI-less handshakes with alert 40 before ciphers are even weighed.
CONFIG_MBEDTLS_SERVER_NAME_INDICATION=y
# The embedded root CAs (certs.h) are PEM text; without PEM support mbedTLS
# holds zero trusted CAs and every verify fails with "got no CA chain".
CONFIG_MBEDTLS_PEM_CERTIFICATE_FORMAT=y
# NIST-curve optimized arithmetic: the software P-384 handshake takes ~67 s
# without it and the peer gives up (-ETIMEDOUT). This is the single largest
# ECC speedup available in software.
CONFIG_MBEDTLS_ECP_NIST_OPTIM=y


# Backlight dimming: the TFT backlight pin (GPIO21) runs on LEDC PWM so
# night mode can dim it; a bare GPIO only offered blinding or blank.
CONFIG_PWM=y

# Flash-encryption compatibility (with the MCUboot boot chain): the flash
# driver routes reads/writes through the encrypted paths once the eFuses
# enable encryption; harmless (virtual) before that.
CONFIG_ESP_FLASH_ENCRYPTION=y
```

## trace.overlay
```dts
/* Touch-trace diagnostic overlay.
 *
 * reads stays at the production 16. An earlier revision of this file forced
 * reads=<1> to expose the per-conversion settling curve, and the board then
 * reported NO touch events at all across two 100 s captures: with a single
 * unaveraged round, the driver's z (Z1 + 4096 - Z2) is one noisy sample
 * against z-threshold=400, so `pressed` never asserts and nothing is reported.
 *
 * It was also the wrong experiment. The transient being measured spans the
 * first few REPORTS after pen-down, not the reads inside one report, so the
 * production value is what should be characterised.
 *
 * The file is kept (rather than dropped) so the trace build keeps an explicit,
 * documented DTS state -- DTS is last-one-wins here and silence is how the
 * stray reads=<3> went unnoticed for days.
 */
&xpt2046 {
	reads = <16>;
};
```

## src/backlight.h
```c
#ifndef BACKLIGHT_H
#define BACKLIGHT_H

#include <stdint.h>

/* Load the persisted level and drive the PWM. Call once, after cfg_init(). */
void backlight_init(void);

/* Step one level in `dir` (+1 brighter, -1 dimmer), clamp to the 20..100
 * scale, persist, and apply. A no-op at the ends. */
void backlight_step(int dir);

/* Set an absolute level, snapped to the 20..100 scale, persisted and applied.
 * A no-op if it is already there. The settings screen picks a level directly
 * now rather than stepping toward one. */
void backlight_set(uint8_t pct);

/* Current backlight percent -- one of 20/40/60/80/100. */
uint8_t backlight_get(void);

/* Pure: the level reached by stepping `cur` by `dir` (+1/-1) within the
 * 20..100 scale in steps of 20. In the header so host tests can reach it. */
static inline uint8_t backlight_next_level(uint8_t cur, int dir)
{
	int v = (int)cur + dir * 20;

	if (v < 20) {
		v = 20;
	}
	if (v > 100) {
		v = 100;
	}
	return (uint8_t)v;
}

#endif /* BACKLIGHT_H */
```
