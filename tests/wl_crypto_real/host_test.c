/* firmware/src/wl_crypto_mbedtls.c, unchanged, on mbedTLS 3.6's own sources,
 * against what pc/wifi_crypto.py produces for the same inputs.
 *
 * The board and the daemon each pass the RFC's vectors alone, and the RFC's
 * vectors stop at 114 bytes. A WiFi frame is 1 to 517 (WL_PT_MAX), and the
 * board emits nothing of a chosen length the PC could sweep on hardware
 * (spec S7.4), so this is where the lengths in between are proved: every
 * plaintext length 0..517 at four counters must seal to the Python's bytes
 * and open back, and 60 frames with one bit flipped must be refused without
 * one byte of plaintext written. vectors.h is generated by
 * tools/gen_aead_vectors.py; tests/test_vectors_are_generated.py keeps it
 * current.
 *
 * Built by tests/ci/check_host_tests.sh (run_one wl_crypto_real), which finds
 * the mbedTLS sources and skips this suite with one line when there are
 * none. stub/ stands in for <zephyr/random/random.h>.
 */
#include <stdio.h>
#include <string.h>

#include "wl_crypto.h"
#include "tests/wl_crypto_real/vectors.h"

static int fails;
/* One PASS line per named check, not per byte: 2072 seals print one line. */
static void check(int ok, const char *name)
{
	if (!ok) {
		fails++;
		printf("FAIL %s\n", name);
	} else {
		printf("PASS %s\n", name);
	}
}

static int csrand_rc;
static unsigned csrand_calls;
int sys_csrand_get(void *dst, size_t len)
{
	csrand_calls++;
	memset(dst, 0x5a, len);
	return csrand_rc;
}

static void wire_nonce(uint64_t ctr, uint8_t nonce[12])
{
	memset(nonce, 0, 4);
	for (int i = 0; i < 8; i++) {
		nonce[4 + i] = (uint8_t)(ctr >> (56 - 8 * i));
	}
}

static void wire_aad(size_t n, uint8_t aad[2])
{
	aad[0] = (uint8_t)(n >> 8);
	aad[1] = (uint8_t)n;
}

static void every_length_seals_to_the_pythons_bytes(void)
{
	int seal_ok = 1, open_ok = 1;
	uint8_t nonce[12], aad[2], ct[WLV_PT_MAX], tag[16], pt[WLV_PT_MAX];

	for (int c = 0; c < WLV_NCTR; c++) {
		const struct wlv_ctr *v = &wlv_ctr[c];

		wire_nonce(v->counter, nonce);
		for (size_t n = 0; n <= WLV_PT_MAX; n++) {
			wire_aad(n, aad);
			memset(ct, 0xa5, sizeof(ct));
			if (wl_aead_seal(v->key, nonce, aad, 2, v->pt, n, ct,
					 tag) != 0 ||
			    memcmp(ct, v->ct, n) != 0 ||
			    memcmp(tag, v->tag[n], 16) != 0) {
				if (seal_ok) {
					printf("  seal differs: counter %d length %zu\n",
					       c, n);
				}
				seal_ok = 0;
			}
			memset(pt, 0xa5, sizeof(pt));
			if (wl_aead_open(v->key, nonce, aad, 2, v->ct, n,
					 v->tag[n], pt) != 0 ||
			    memcmp(pt, v->pt, n) != 0) {
				if (open_ok) {
					printf("  open differs: counter %d length %zu\n",
					       c, n);
				}
				open_ok = 0;
			}
		}
	}
	check(seal_ok, "seal_every_length_every_counter_matches_python");
	check(open_ok, "open_every_length_every_counter_recovers_pt");
}

static void every_corrupted_frame_is_refused_unwritten(void)
{
	int ok = 1;
	uint8_t nonce[12], aad[2], ct[WLV_PT_MAX], tag[16], pt[WLV_PT_MAX];
	uint8_t untouched[WLV_PT_MAX];

	memset(untouched, 0xa5, sizeof(untouched));
	for (int i = 0; i < WLV_NBAD; i++) {
		const struct wlv_bad *b = &wlv_bad[i];
		const struct wlv_ctr *v = &wlv_ctr[b->ctr];
		uint8_t *field;

		wire_nonce(v->counter, nonce);
		wire_aad(b->n, aad);
		memcpy(ct, v->ct, b->n);
		memcpy(tag, v->tag[b->n], 16);
		field = b->field == WLV_BAD_CT ? ct
			: b->field == WLV_BAD_AAD ? aad : tag;
		field[b->byte] ^= (uint8_t)(1u << b->bit);

		memset(pt, 0xa5, sizeof(pt));
		if (wl_aead_open(v->key, nonce, aad, 2, ct, b->n, tag, pt) != -1 ||
		    memcmp(pt, untouched, sizeof(pt)) != 0) {
			if (ok) {
				printf("  corrupted case %d accepted or wrote\n", i);
			}
			ok = 0;
		}
	}
	check(ok, "open_refuses_every_corrupted_case_writing_nothing");
}

/* wl_frame seals and opens in one buffer; mbedTLS's ChaCha20 supports it. */
static void in_place_both_ways(void)
{
	const struct wlv_ctr *v = &wlv_ctr[3];
	uint8_t nonce[12], aad[2], buf[WLV_PT_MAX], tag[16];

	wire_nonce(v->counter, nonce);
	wire_aad(WLV_PT_MAX, aad);
	memcpy(buf, v->pt, WLV_PT_MAX);
	check(wl_aead_seal(v->key, nonce, aad, 2, buf, WLV_PT_MAX, buf, tag) == 0 &&
	      memcmp(buf, v->ct, WLV_PT_MAX) == 0 &&
	      memcmp(tag, v->tag[WLV_PT_MAX], 16) == 0,
	      "seal_in_place");
	check(wl_aead_open(v->key, nonce, aad, 2, buf, WLV_PT_MAX, tag, buf) == 0 &&
	      memcmp(buf, v->pt, WLV_PT_MAX) == 0,
	      "open_in_place");
}

static void hmac_and_hkdf_match_python(void)
{
	int ok = 1;
	uint8_t out[64];

	for (int i = 0; i < WLV_NHMAC; i++) {
		const struct wlv_hmac *h = &wlv_hmac[i];

		memset(out, 0, sizeof(out));
		if (wl_hmac_sha256(h->key, 32, h->msg, h->n, out) != 0 ||
		    memcmp(out, h->mac, 32) != 0) {
			ok = 0;
		}
	}
	check(ok, "hmac_handshake_shapes_match_python");

	ok = 1;
	for (int i = 0; i < WLV_NHKDF; i++) {
		const struct wlv_hkdf *h = &wlv_hkdf[i];

		memset(out, 0, sizeof(out));
		if (wl_hkdf_sha256(h->salt, 32, h->ikm, 32,
				   (const uint8_t *)wlv_hkdf_info,
				   sizeof(wlv_hkdf_info) - 1, out, 64) != 0 ||
		    memcmp(out, h->okm, 64) != 0) {
			ok = 0;
		}
	}
	check(ok, "hkdf_session_keys_match_python");
}

static void random_and_ct_equal(void)
{
	uint8_t r[16];

	csrand_rc = 0;
	csrand_calls = 0;
	check(wl_random(r, sizeof(r)) == 0 && csrand_calls == 1,
	      "random_draws_from_csrand");
	csrand_rc = -5;
	check(wl_random(r, sizeof(r)) < 0, "random_reports_csrand_failure");
	csrand_rc = 0;

	check(wl_ct_equal(wlv_ctr[0].key, wlv_ctr[0].key, 32) == 1,
	      "ct_equal_equal");
	memcpy(r, wlv_ctr[0].key, 16);
	r[15] ^= 0x80;
	check(wl_ct_equal(wlv_ctr[0].key, r, 16) == 0,
	      "ct_equal_differs_in_the_last_bit");
}

int main(void)
{
	every_length_seals_to_the_pythons_bytes();
	every_corrupted_frame_is_refused_unwritten();
	in_place_both_ways();
	hmac_and_hkdf_match_python();
	random_and_ct_equal();
	check(wl_crypto_selftest() == 0, "boot_selftest_passes");

	if (fails) {
		printf("%d check(s) failed\n", fails);
		return 1;
	}
	return 0;
}
